## conf/layer.conf
```bitbake
# We have a conf and classes directory, add to BBPATH
BBPATH .= ":${LAYERDIR}"

# We have recipes-* directories, add to BBFILES
BBFILES += "${LAYERDIR}/recipes-*/*.bb \
            ${LAYERDIR}/recipes-*/*/*.bb \
            ${LAYERDIR}/recipes-*/*/*.bbappend"

BBFILE_COLLECTIONS += "meta-iceoryx2"
BBFILE_PATTERN_meta-iceoryx2 = "^${LAYERDIR}/"
BBFILE_PRIORITY_meta-iceoryx2 = "6"

# Only increment for breaking changes
LAYERVERSION_meta-iceoryx2 = "2"
LAYERDEPENDS_meta-iceoryx2 = "core"
LAYERSERIES_COMPAT_meta-iceoryx2 = "\
    kirkstone \
    scarthgap \
"

ICEORYX2_VERSION ??= "0.8.1"

PREFERRED_VERSION_iceoryx2 = "${ICEORYX2_VERSION}"
PREFERRED_VERSION_iceoryx2-validation-suite = "${ICEORYX2_VERSION}"
PREFERRED_VERSION_iceoryx2-c = "${ICEORYX2_VERSION}"
PREFERRED_VERSION_iceoryx2-c-examples = "${ICEORYX2_VERSION}"
PREFERRED_VERSION_iceoryx2-cmake-modules = "${ICEORYX2_VERSION}"
PREFERRED_VERSION_iceoryx2-cxx = "${ICEORYX2_VERSION}"
PREFERRED_VERSION_iceoryx2-cxx-examples = "${ICEORYX2_VERSION}"
```

## examples/meta-iceoryx2-append-layer/conf/layer.conf
```bitbake
# We have a conf and classes directory, add to BBPATH
BBPATH .= ":${LAYERDIR}"

# We have recipes-* directories, add to BBFILES
BBFILES += "${LAYERDIR}/recipes/*.bbappend"

LAYERSERIES_COMPAT_meta-iceoryx2 = "\
    kirkstone \
    scarthgap \
"

# Uncomment to overwrite the preferred iceoryx2 version
#ICEORYX2_VERSION = "git"
```
